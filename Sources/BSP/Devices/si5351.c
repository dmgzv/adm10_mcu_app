#include "si5351.h"

/* Si5351ABC I2C Programming Procedure
 * 1. Disable Outputs. Reg. 3 = 0xFF
 * 2. Powerdown all output drivers. Reg. 16, 17, 18, 19, 20, 21, 22, 23 = 0x80
 * 3. Set interrupt masks. Unmask all interupts Reg. 2 = 0x00
 * 4. Write new configuration to device using the contents of the register map generated by ClockBuilder Desktop.
 *    This step also powers up the output drivers. (Reg. 15-92 and 149-170)
 * 5. Apply PLLA and PLLB soft reset Reg. 177 = 0xAC
 * 6. Enable desired outputs. Reg. 3
 */

static int32_t SI5351_Config(SI5351_T *Dev, const SI5351_CFG_T *Config, const uint32_t ConfigSize, uint8_t OutsMask)
{
	uint32_t i;
	uint8_t Addr;
	uint8_t Data;
		
	Addr = 3;
	Data = 0xFF;
	if (I2C_Sequential_Transmit(Dev->I2C, Dev->Addr, &Addr, 1, (char*)&Data, 1))
		return -1;
	
	for (i = 0; i < 8; i++)
	{
		Addr = 16 + i;
		Data = 0x80;
		if (I2C_Sequential_Transmit(Dev->I2C, Dev->Addr, &Addr, 1, (char*)&Data, 1))
			return -1;
	}
	
	Addr = 2;
	Data = 0x00;
	if (I2C_Sequential_Transmit(Dev->I2C, Dev->Addr, &Addr, 1, (char*)&Data, 1))
		return -1;
	
	for (i = 0; i < ConfigSize; i++)
	{
		if (I2C_Sequential_Transmit(Dev->I2C, Dev->Addr, (uint8_t*)&Config[i].Addr, 1, (char*)&Config[i].Data, 1))
			return -1;
	}

	Addr = 177;
	Data = 0xAC;
	if (I2C_Sequential_Transmit(Dev->I2C, Dev->Addr, &Addr, 1, (char*)&Data, 1))
		return -1;
	
	Addr = 3;
	Data = ~OutsMask;
	if (I2C_Sequential_Transmit(Dev->I2C, Dev->Addr, &Addr, 1, (char*)&Data, 1))
		return -1;
	
	return 0;
}

int32_t SI5351_Init(SI5351_T *Dev, I2C_TypeDef *I2C, uint8_t Addr, const SI5351_CFG_T *Config, const uint32_t ConfigSize, uint8_t OutsMask)
{
	uint8_t Reg;
	uint8_t Data;
	
	if ((!Dev) || (!I2C) || ((Addr != 0x60) && (Addr != 0x61)))
		return -1;
	
	BSP_DEV_INIT(Dev);
	BSP_DEV_LOCK(Dev);
	
	Dev->I2C = I2C;
	Dev->Addr = Addr << 1;
	
	Reg = 0x00;
	if (I2C_Sequential_Receive(Dev->I2C, Dev->Addr, &Reg, 1, (char*)&Data, 1))
		goto error;	
	Dev->Status = Reg;
	
	if (SI5351_Config(Dev, Config, ConfigSize, OutsMask))
		goto error;	
	
	BSP_DEV_SET_STATE(Dev, BSP_DEV_STATE_OK);
	BSP_DEV_UNLOCK(Dev);
	return 0;
	
error:
	BSP_DEV_SET_STATE(Dev, BSP_DEV_STATE_FAIL);
	BSP_DEV_UNLOCK(Dev);
	return -1;
}

void SI5351_Deinit(SI5351_T *Dev)
{
	if (!Dev)
		return;
	BSP_DEV_DEINIT(Dev);
}
